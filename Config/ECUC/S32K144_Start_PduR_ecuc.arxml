AUTOSAR XML (schema 4-2-1)
package /ActiveEcuC
  module config PduR: implementation-config-variant=VARIANT-PRE-COMPILE, module-description=PduR_Impl
    PduRGeneral:
      PduRDevErrorDetect = true
      PduRVersionInfoApi = false
      PduRMetaDataSupport = false
      PduRPduCallback = false
      PduRSwitching = false
      PduRSafeBswChecks = false
      PduREnableDeferredTransmission = false
      PduREnableDeferredReception = false
      PduRSupportMulticore = false
      PduRGeneration:
        PduROutOfBoundsWriteProtectionStrategy = NONE
        PduROutOfBoundsWriteSanitizer = false
        PduROutOfBoundsReadSanitizer = false
        PduRNumericalDataTypeMinimizationStrategy = WITH_CAST
        PduRReduceConstantData2Define = false
        PduRBoolDataInArrayOfStructStrategy = BITMASKING
        PduRDeduplicateIndirectedData = true
        PduRDataDeduplicationStrategy = WITH_CAST
        PduRReduceBoolDataByNegationThreshold = 2
        PduRReduceBoolDataByNumericalComparisonThreshold = 2
        PduRReduceBoolDataByNumericalRelationThreshold = 2
        PduRReduceBoolDataByNumericalOperandStrategy = WITH_ANY_VALUE
        PduRReduceNumericalDataByOffsetThreshold = 2
        PduRReduceNumericalDataByArraySubtractionThreshold = 2
        PduRReduceDataByStreaming = false
        PduRShortSymbols = false
        PduRInterfacesForDeactivatedData = false
        PduRReferringKeysInComments = false
    PduRRoutingTables: PduRConfigurationId=0
      PduRRoutingTable
        9 x PduRRoutingPath, all with PduRLockRef=PduRLock_PduRExclusiveArea:
          msg_diag_Request_MyECU_oCAN00_a823f7ba_Rx: PduRRoutingPathCommunicationType=TRANSPORT_PROTOCOL
            msg_diag_Request_MyECU_oCAN00_a823f7ba_Rx_11d927ad_Rx (PduRDestPdu):
              PduRDestPduHandleId = 1
              PduRDestPduDirection = RECEIVE
              PduRDestPduRoutingType = API_FORWARDING
              PduRDestPduDataProcessing = IMMEDIATE
              PduRPduLengthHandlingStrategy = UNUSED
              PduRDestPduRef = msg_diag_Request_MyECU_oCAN00_956934ec_Rx
              PduRDestPduPduRBswModulesRef = Dcm
            PduRSrcPdu_11d927ad (PduRSrcPdu): PduRSourcePduHandleId=1, PduRSrcPduDirection=RECEIVE, PduRSrcPduRef=msg_diag_Request_MyECU_oCAN00_a823f7ba_Rx, PduRSrcPduPduRBswModulesRef=CanTp
          msg_MyECU_Lamp_oCAN00_818e1651_Tx: PduRRoutingPathCommunicationType=COMMUNICATION_INTERFACE
            PduRSrcPdu_8e8b997f (PduRSrcPdu): PduRSourcePduHandleId=1, PduRSrcPduDirection=TRANSMIT, PduRSrcPduRef=msg_MyECU_Lamp_oCAN00_818e1651_Tx, PduRSrcPduPduRBswModulesRef=Com
            msg_MyECU_Lamp_oCAN00_26f3473b_Tx (PduRDestPdu):
              PduRDestPduHandleId = 1
              PduRDestPduDirection = TRANSMIT
              PduRDestPduRoutingType = API_FORWARDING
              PduRDestPduDataProcessing = IMMEDIATE
              PduRPduLengthHandlingStrategy = UNUSED
              PduRDestPduDataProvision = PDUR_DIRECT
              PduRTransmissionConfirmation = true
              PduRDestPduRef = msg_MyECU_Lamp_oCAN00_26f3473b_Tx
              PduRDestPduPduRBswModulesRef = CanIf
          msg_Receive_oCAN00_3867e0b8_Rx: PduRRoutingPathCommunicationType=COMMUNICATION_INTERFACE
            PduRSrcPdu_16740ed0 (PduRSrcPdu): PduRSourcePduHandleId=1, PduRSrcPduDirection=RECEIVE, PduRSrcPduRef=msg_Receive_oCAN00_3867e0b8_Rx, PduRSrcPduPduRBswModulesRef=CanIf
            msg_Receive_oCAN00_3867e0b8_Rx_16740ed0_Rx (PduRDestPdu):
              PduRDestPduHandleId = 1
              PduRDestPduDirection = RECEIVE
              PduRDestPduRoutingType = API_FORWARDING
              PduRDestPduDataProcessing = IMMEDIATE
              PduRPduLengthHandlingStrategy = UNUSED
              PduRTransmissionConfirmation = false
              PduRDestPduRef = msg_Receive_oCAN00_2b456e3f_Rx
              PduRDestPduPduRBswModulesRef = Com
          msg_diag_RequestGlobal_oCAN00_38f4a687_Rx: PduRRoutingPathCommunicationType=TRANSPORT_PROTOCOL
            msg_diag_RequestGlobal_oCAN00_38f4a687_Rx_fdd5755a_Rx (PduRDestPdu):
              PduRDestPduHandleId = 0
              PduRDestPduDirection = RECEIVE
              PduRDestPduRoutingType = API_FORWARDING
              PduRDestPduDataProcessing = IMMEDIATE
              PduRPduLengthHandlingStrategy = UNUSED
              PduRDestPduRef = msg_diag_RequestGlobal_oCAN00_25be229e_Rx
              PduRDestPduPduRBswModulesRef = Dcm
            PduRSrcPdu_fdd5755a (PduRSrcPdu): PduRSourcePduHandleId=0, PduRSrcPduDirection=RECEIVE, PduRSrcPduRef=msg_diag_RequestGlobal_oCAN00_38f4a687_Rx, PduRSrcPduPduRBswModulesRef=CanTp
          msg_Transmit_oCAN00_0723e95e_Tx: PduRRoutingPathCommunicationType=COMMUNICATION_INTERFACE
            PduRSrcPdu_087fd70d (PduRSrcPdu): PduRSourcePduHandleId=3, PduRSrcPduDirection=TRANSMIT, PduRSrcPduRef=msg_Transmit_oCAN00_0723e95e_Tx, PduRSrcPduPduRBswModulesRef=Com
            msg_Transmit_oCAN00_9631a86b_Tx (PduRDestPdu):
              PduRDestPduHandleId = 3
              PduRDestPduDirection = TRANSMIT
              PduRDestPduRoutingType = API_FORWARDING
              PduRDestPduDataProcessing = IMMEDIATE
              PduRPduLengthHandlingStrategy = UNUSED
              PduRDestPduDataProvision = PDUR_DIRECT
              PduRTransmissionConfirmation = true
              PduRDestPduRef = msg_Transmit_oCAN00_9631a86b_Tx
              PduRDestPduPduRBswModulesRef = CanIf
          msg_diag_Response_MyECU_oCAN00_f4dcbbcd_Tx: PduRRoutingPathCommunicationType=TRANSPORT_PROTOCOL
            PduRSrcPdu_f4835c60 (PduRSrcPdu): PduRSourcePduHandleId=4, PduRSrcPduDirection=TRANSMIT, PduRSrcPduRef=msg_diag_Response_MyECU_oCAN00_f4dcbbcd_Tx, PduRSrcPduPduRBswModulesRef=Dcm
            msg_diag_Response_MyECU_oCAN00_45311294_Tx (PduRDestPdu):
              PduRDestPduHandleId = 0
              PduRDestPduDirection = TRANSMIT
              PduRDestPduRoutingType = API_FORWARDING
              PduRDestPduDataProcessing = IMMEDIATE
              PduRPduLengthHandlingStrategy = UNUSED
              PduRDestPduRef = msg_diag_Response_MyECU_oCAN00_45311294_Tx
              PduRDestPduPduRBswModulesRef = CanTp
          MyECU2_Pdur_CAN_Network: PduRRoutingPathCommunicationType=COMMUNICATION_INTERFACE
            PduRDestPdu:
              PduRDestPduHandleId = 0
              PduRDestPduDirection = TRANSMIT
              PduRDestPduRoutingType = API_FORWARDING
              PduRDestPduDataProcessing = IMMEDIATE
              PduRPduLengthHandlingStrategy = UNUSED
              PduRDestPduDataProvision = PDUR_DIRECT
              PduRTransmissionConfirmation = true
              PduRDestPduRef = MyECU2_Ipdu_pdur2canif
              PduRDestPduPduRBswModulesRef = CanIf
            PduRSrcPdu: PduRSourcePduHandleId=0, PduRSrcPduDirection=TRANSMIT, PduRSrcPduRef=MyECU2_Ipdu_com2pdur, PduRSrcPduPduRBswModulesRef=Com
          msg_Receive02_oCAN00_005193a0_Rx: PduRRoutingPathCommunicationType=COMMUNICATION_INTERFACE
            PduRSrcPdu_f4d76485 (PduRSrcPdu): PduRSourcePduHandleId=0, PduRSrcPduDirection=RECEIVE, PduRSrcPduRef=msg_Receive02_oCAN00_005193a0_Rx, PduRSrcPduPduRBswModulesRef=CanIf
            msg_Receive02_oCAN00_005193a0_Rx_f4d76485_Rx (PduRDestPdu):
              PduRDestPduHandleId = 0
              PduRDestPduDirection = RECEIVE
              PduRDestPduRoutingType = API_FORWARDING
              PduRDestPduDataProcessing = IMMEDIATE
              PduRPduLengthHandlingStrategy = UNUSED
              PduRTransmissionConfirmation = false
              PduRDestPduRef = msg_Receive02_oCAN00_efcf250a_Rx
              PduRDestPduPduRBswModulesRef = Com
          msg_Transmit02_oCAN00_e0f54509_Tx: PduRRoutingPathCommunicationType=COMMUNICATION_INTERFACE
            PduRSrcPdu_7ab78d89 (PduRSrcPdu): PduRSourcePduHandleId=2, PduRSrcPduDirection=TRANSMIT, PduRSrcPduRef=msg_Transmit02_oCAN00_e0f54509_Tx, PduRSrcPduPduRBswModulesRef=Com
            msg_Transmit02_oCAN00_d2436288_Tx (PduRDestPdu):
              PduRDestPduHandleId = 2
              PduRDestPduDirection = TRANSMIT
              PduRDestPduRoutingType = API_FORWARDING
              PduRDestPduDataProcessing = IMMEDIATE
              PduRPduLengthHandlingStrategy = UNUSED
              PduRDestPduDataProvision = PDUR_DIRECT
              PduRTransmissionConfirmation = true
              PduRDestPduRef = msg_Transmit02_oCAN00_d2436288_Tx
              PduRDestPduPduRBswModulesRef = CanIf
      PduRLock_PduRExclusiveArea (PduRLock)
        PduRExclusiveArea: PduRExclusiveAreaId=0
    4 x PduRBswModules, all with PduRCancelReceive=false, PduRCancelTransmit=false, PduRChangeParameterRequestApi=false, PduRTriggertransmit=false:
      CanIf: PduRCommunicationInterface=true, PduRLowerModule=true, PduRTransportProtocol=false, PduRTxConfirmation=true, PduRUpperModule=false, PduRUseTag=false, PduRBswModuleRef=CanIf
      CanTp: PduRCommunicationInterface=false, PduRLowerModule=true, PduRTransportProtocol=true, PduRTxConfirmation=false, PduRUpperModule=false, PduRUseTag=false, PduRBswModuleRef=CanTp
      Com: PduRCommunicationInterface=true, PduRLowerModule=false, PduRTransportProtocol=false, PduRTxConfirmation=true, PduRUpperModule=true, PduRUseTag=false, PduRBswModuleRef=Com
      Dcm: PduRCommunicationInterface=false, PduRLowerModule=false, PduRTransportProtocol=true, PduRTxConfirmation=false, PduRUpperModule=true, PduRUseTag=true, PduRBswModuleRef=Dcm
