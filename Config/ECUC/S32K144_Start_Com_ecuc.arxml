AUTOSAR XML (schema 4-2-1)
package /ActiveEcuC
  module config Com: implementation-config-variant=VARIANT-PRE-COMPILE, module-description=Com_Impl
    ComGeneration:
      ComOutOfBoundsWriteProtectionStrategy = NONE
      ComOutOfBoundsWriteSanitizer = false
      ComOutOfBoundsReadSanitizer = false
      ComReduceConstantData2Define = false
      ComBoolDataInArrayOfStructStrategy = BOOLEAN
      ComDeduplicateIndirectedData = true
      ComDataDeduplicationStrategy = WITH_CAST
      ComReduceBoolDataByNegationThreshold = 2
      ComReduceBoolDataByNumericalComparisonThreshold = 2
      ComReduceBoolDataByNumericalRelationThreshold = 2
      ComReduceBoolDataByNumericalOperandStrategy = WITH_ANY_VALUE
      ComReduceNumericalDataByOffsetThreshold = 2
      ComReduceNumericalDataByArraySubtractionThreshold = 2
      ComReduceDataByStreaming = false
      ComShortSymbols = false
      ComInterfacesForDeactivatedData = false
      ComReferringKeysInComments = false
    ComOptimization:
      ComTxCyclicProcessingISRLockThreshold = 1
      ComTxDeadlineMonitoringISRLockThreshold = 1
      ComTxProcessingISRLockThreshold = 1
      ComRxDeadlineMonitoringISRLockThreshold = 1
      ComRxDeferredProcessingISRLockThreshold = 1
      ComGatewayProcessingISRLockThreshold = 1
      ComGatewayDescriptionProcessingISRLockThreshold = 1
      ComIPduGroupISRLockThreshold = 1
    ComConfig: ComConfigurationId=0, ComRxDeferredNotificationCacheSize=1, ComRxImmediateNotificationCacheSize=0
      MyECU_oCAN00_Rx_4cbf71f7 (ComIPduGroup): ComIPduGroupHandleId=0
      sig_State_RearLeftDoor_omsg_Receive_oCAN00_84ad4140_Rx (ComSignal):
        ComBitPosition = 0
        ComBitSize = 1
        ComSignalEndianness = LITTLE_ENDIAN
        ComSignalInitValue = 0
        ComSignalType = BOOLEAN
        ComTimeout = 0
        ComSignalAccess = ACCESS_UNCLEAR
        ComHandleId = 1
        ComSystemTemplateSystemSignalRef = sig_State_RearLeftDoor
      sig_LampCnt_omsg_MyECU_Lamp_oCAN00_f37e68ea_Tx (ComSignal):
        ComBitPosition = 7
        ComBitSize = 8
        ComSignalEndianness = BIG_ENDIAN
        ComSignalInitValue = 0
        ComSignalType = UINT8
        ComTransferProperty = PENDING
        ComSignalAccess = ACCESS_UNCLEAR
        ComHandleId = 1
        ComSystemTemplateSystemSignalRef = sig_LampCnt
      ComTimeBase: ComRxTimeBase=0.01, ComTxTimeBase=0.01, ComGwTimeBase=0.01
      msg_Transmit_oCAN00_0723e95e_Tx (ComIPdu):
        ComIPduDirection = SEND
        ComIPduType = NORMAL
        ComIPduHandleId = 3
        ComIPduSignalProcessing = DEFERRED
        ComIPduCancellationSupport = false
        ComIPduGroupRef = MyECU_oCAN00_Tx_1ae5d671
        ComIPduSignalRef = sig_RearInteriorLight_omsg_Transmit_oCAN00_49a633c1_Tx
        ComPduIdRef = msg_Transmit_oCAN00_0723e95e_Tx
        ComTxIPdu: ComMinimumDelayTime=0, ComTxIPduUnusedAreasDefault=0
          ComTxModeTrue
            ComTxMode: ComTxModeMode=DIRECT, ComTxModeTimeOffset=0, ComTxModeTimePeriod=0, ComTxModeNumberOfRepetitions=3, ComTxModeRepetitionPeriod=0.01
          ComTxModeFalse
            ComTxMode: ComTxModeMode=PERIODIC, ComTxModeTimeOffset=0, ComTxModeTimePeriod=0.1
      sig_State_RearInteriorLight_omsg_Receive_oCAN00_63323183_Rx (ComSignal):
        ComBitPosition = 2
        ComBitSize = 1
        ComSignalEndianness = LITTLE_ENDIAN
        ComSignalInitValue = 0
        ComSignalType = BOOLEAN
        ComTimeout = 0
        ComSignalAccess = ACCESS_UNCLEAR
        ComHandleId = 0
        ComSystemTemplateSystemSignalRef = sig_State_RearInteriorLight
      sig_State_RearRightDoor_omsg_Receive_oCAN00_a8945098_Rx (ComSignal):
        ComBitPosition = 1
        ComBitSize = 1
        ComSignalEndianness = LITTLE_ENDIAN
        ComSignalInitValue = 0
        ComSignalType = BOOLEAN
        ComTimeout = 0
        ComSignalAccess = ACCESS_UNCLEAR
        ComHandleId = 2
        ComSystemTemplateSystemSignalRef = sig_State_RearRightDoor
      msg_Receive_oCAN00_2b456e3f_Rx (ComIPdu):
        ComIPduDirection = RECEIVE
        ComIPduType = NORMAL
        ComIPduHandleId = 1
        ComIPduSignalProcessing = DEFERRED
        ComIPduCancellationSupport = false
        ComIPduGroupRef = MyECU_oCAN00_Rx_4cbf71f7
        ComIPduSignalRef = sig_State_RearInteriorLight_omsg_Receive_oCAN00_63323183_Rx
        ComIPduSignalRef = sig_State_RearLeftDoor_omsg_Receive_oCAN00_84ad4140_Rx
        ComIPduSignalRef = sig_State_RearRightDoor_omsg_Receive_oCAN00_a8945098_Rx
        ComPduIdRef = msg_Receive_oCAN00_2b456e3f_Rx
      MyECU_oCAN00_Tx_1ae5d671 (ComIPduGroup): ComIPduGroupHandleId=1
      msg_MyECU_Lamp_oCAN00_818e1651_Tx (ComIPdu):
        ComIPduDirection = SEND
        ComIPduType = NORMAL
        ComIPduHandleId = 1
        ComIPduSignalProcessing = IMMEDIATE
        ComIPduCancellationSupport = false
        ComIPduGroupRef = MyECU_oCAN00_Tx_1ae5d671
        ComIPduSignalRef = sig_LampCnt_omsg_MyECU_Lamp_oCAN00_f37e68ea_Tx
        ComPduIdRef = msg_MyECU_Lamp_oCAN00_818e1651_Tx
        ComTxIPdu: ComMinimumDelayTime=0, ComTxIPduUnusedAreasDefault=0
          ComTxModeTrue
            ComTxMode: ComTxModeMode=DIRECT, ComTxModeTimeOffset=0, ComTxModeTimePeriod=0, ComTxModeNumberOfRepetitions=3, ComTxModeRepetitionPeriod=0.01
          ComTxModeFalse
            ComTxMode: ComTxModeMode=PERIODIC, ComTxModeTimeOffset=0, ComTxModeTimePeriod=0.1
      sig_RearInteriorLight_omsg_Transmit_oCAN00_49a633c1_Tx (ComSignal):
        ComBitPosition = 0
        ComBitSize = 1
        ComSignalEndianness = LITTLE_ENDIAN
        ComSignalInitValue = 0
        ComSignalType = BOOLEAN
        ComTransferProperty = PENDING
        ComSignalAccess = ACCESS_UNCLEAR
        ComHandleId = 2
        ComSystemTemplateSystemSignalRef = sig_RearInteriorLight
      RearLeft_Window (ComSignal):
        ComBitPosition = 0
        ComSignalEndianness = LITTLE_ENDIAN
        ComSignalInitValue = 0
        ComSignalType = BOOLEAN
        ComSignalAccess = ACCESS_UNCLEAR
        ComHandleId = 0
        ComBitSize = 1
        ComTransferProperty = PENDING
      3 x ComIPdu, all with ComIPduType=NORMAL, ComIPduCancellationSupport=false:
        MyECU2_Com_CAN_Network: ComIPduDirection=SEND, ComIPduHandleId=0, ComIPduSignalProcessing=IMMEDIATE, ComPduIdRef=MyECU2_Ipdu_com2pdur, ComIPduGroupRef=MyECU_oCAN00_Tx_1ae5d671, ComIPduSignalRef=RearLeft_Window
          ComTxIPdu: ComMinimumDelayTime=0, ComTxIPduUnusedAreasDefault=0
            ComTxModeFalse
              ComTxMode: ComTxModeMode=NONE
            ComTxModeTrue
              ComTxMode: ComTxModeMode=DIRECT, ComTxModeNumberOfRepetitions=3, ComTxModeRepetitionPeriod=0.01
        msg_Receive02_oCAN00_efcf250a_Rx: ComIPduDirection=RECEIVE, ComIPduHandleId=0, ComIPduSignalProcessing=DEFERRED, ComIPduGroupRef=MyECU_oCAN00_Rx_4cbf71f7, ComIPduSignalRef=sig_new_myecu_receive02_omsg_Receive02_oCAN00_c1e66b88_Rx, ComIPduSignalRef=sig_new_myecu_receive_omsg_Receive02_oCAN00_7aab36dc_Rx, ComPduIdRef=msg_Receive02_oCAN00_efcf250a_Rx
        msg_Transmit02_oCAN00_e0f54509_Tx: ComIPduDirection=SEND, ComIPduHandleId=2, ComIPduSignalProcessing=DEFERRED, ComIPduGroupRef=MyECU_oCAN00_Tx_1ae5d671, ComIPduSignalRef=sig_new_myecu_Send_omsg_Transmit02_oCAN00_778664dc_Tx, ComPduIdRef=msg_Transmit02_oCAN00_e0f54509_Tx
          ComTxIPdu: ComMinimumDelayTime=0, ComTxIPduUnusedAreasDefault=0
            ComTxModeTrue
              ComTxMode: ComTxModeMode=DIRECT, ComTxModeTimeOffset=0, ComTxModeTimePeriod=0, ComTxModeNumberOfRepetitions=3, ComTxModeRepetitionPeriod=0.01
            ComTxModeFalse
              ComTxMode: ComTxModeMode=NONE
      3 x ComSignal, all with ComSignalEndianness=LITTLE_ENDIAN, ComSignalInitValue=0, ComSignalAccess=ACCESS_UNCLEAR:
        sig_new_myecu_receive02_omsg_Receive02_oCAN00_c1e66b88_Rx: ComBitPosition=56, ComBitSize=8, ComSignalType=UINT8, ComTimeout=1, ComHandleId=3, ComFirstTimeout=1, ComNotification=ComCbkRx_Receive02Cbk, ComRxDataTimeoutAction=NONE, ComTimeoutNotification=ComCbk_Receive02TimeoutCbk, ComSystemTemplateSystemSignalRef=sig_new_myecu_receive02
        sig_new_myecu_receive_omsg_Receive02_oCAN00_7aab36dc_Rx: ComBitPosition=0, ComBitSize=8, ComSignalType=UINT8, ComTimeout=0, ComHandleId=4, ComSystemTemplateSystemSignalRef=sig_new_myecu_receive
        sig_new_myecu_Send_omsg_Transmit02_oCAN00_778664dc_Tx: ComBitPosition=0, ComBitSize=1, ComSignalType=BOOLEAN, ComTransferProperty=TRIGGERED, ComHandleId=3, ComSystemTemplateSystemSignalRef=sig_new_myecu_Send
    ComGeneral:
      ComConfigurationUseDet = true
      ComEnableSignalGroupArrayApi = false
      ComRetryFailedTransmitRequests = false
      ComSupportedIPduGroups = 2
      ComVersionInfoApi = false
      ComAdvancedIPduCallouts = true
      ComOptimizedIPduGroupHandling = false
      ComMetaDataSupport = false
      ComReceiveSignalMacroAPI = false
      ComDeferredEventCacheSupport = false
      ComMainfunctionTimingDomainSupport = false
      ComDescriptionRoutingCodeGeneration = false
      ComSafeBswChecks = false
      ComUserCbkHeaderFile = Appl_Cbk.h
